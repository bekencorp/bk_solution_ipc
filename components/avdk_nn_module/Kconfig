## components/avdk_nn_module/Kconfig
```kconfig
# KCONFIG_GROUP: Solution & Product
menu "AVDK NN Module"

	config TFLM_PERSON_DETECTION_GRAY
		depends on TFLITE_MICRO
		bool "Use tflm person detection gray model with NV12 MP input"
		default n

	config TFLM_PERSON_DETECTION_RGB
		depends on TFLITE_MICRO
		bool "Use tflm person detection RGB model with BGRA MP input"
		default n

	config TFLM_FACE_DETECTION
		depends on TFLITE_MICRO
		depends on NPU
		bool "Use tflm face detection model with ISP SP input"
		default n

endmenu
```

## components/multimedia_device_service/Kconfig
```kconfig
# KCONFIG_GROUP: Solution & Product
menu "Doorbell Service"
    config APP_USE_ISP_MP_CHANNEL
        depends on ISP
        bool "app layer open isp mp channel default"
        default y

    config MDS_SNAPSHOT
        bool "Enable snapshot capture module (JPEG HW/SW)"
        default n
        help
            Build snapshot capture into multimedia_device_service.
            Enable this option when snapshot CLI / doorbell capture is needed.

    config MDS_CLI
        bool "Enable multimedia device debug CLI"
        default y
        help
            Build camera/display/GPU joint-test commands. Disable this for
            headless products that do not need multimedia hardware test CLI.
endmenu
```

## components/video_osd/Kconfig
```kconfig
menu "Video OSD"

    config VIDEO_OSD
        bool "Build video_osd (H264 encoder OSD time overlay)"
        default n

endmenu
```

## projects/pt_camera/ap/Kconfig.projbuild
```kconfig
menu "PT Camera Configuration"

    config PT_TRACKING
        bool "Enable pan-tilt face tracking"
        depends on TFLITE_MICRO
        depends on NPU
        select TFLM_FACE_DETECTION
        default y
        help
            Enable the face detection and PT motor tracking flow. When enabled,
            the tracking task owns camera startup and doorbell camera open/close
            skips the MIPI camera power operations.

endmenu
```

## projects/pt_camera_frame/ap/Kconfig.projbuild
```kconfig
menu "PT Camera Configuration"

    config PT_MP_H264_FRAME_MODE
        bool "MP path: frame-mode H264 with temporal NDR (zero-copy bond)"
        default y
        help
            Run the MP (main path) ISP -> H264 pipeline in frame mode instead of
            flexa, and insert a project-local temporal NDR (3D noise reduction)
            bond before the encoder. The bond takes over the MP channel via
            bk_isp_camera_channel_acquire(), pumps frames zero-copy on its own
            thread, blends when ISO/motion gates allow, then feeds the frame
            encoder via bk_h264_encode_set_input(). When unset the project falls
            back to the stock flexa ISP->H264 bond.

    config PT_TRACKING
        bool "Enable pan-tilt face tracking"
        depends on TFLITE_MICRO
        depends on NPU
        select TFLM_FACE_DETECTION
        default y
        help
            Enable the face detection and PT motor tracking flow. When enabled,
            the tracking task owns camera startup and doorbell camera open/close
            skips the MIPI camera power operations.

endmenu
```
